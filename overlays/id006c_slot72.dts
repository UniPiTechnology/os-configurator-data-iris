/dts-v1/;


/plugin/;

/ {
	fragment@1 {
		
		target = <&ecspi2>;
		__overlay__ {
			status = "okay";
			#address-cells = <1>;
			#size-cells = <0>;

			unipispi72: unipispi@1 {
				compatible = "unipispi";
				reg = <1>;
				status = "okay";
				spi-max-frequency = <12000000>;
				modbus-address = <72>;
				neuron-board-index = <1>;
			};
		};

	};

	fragment@2 {
		target = <&unipispi72>;
		__overlay__ {
			#address-cells = <1>;
			#size-cells = <0>;

			iogroup72 {
				reg = <72>;
				compatible = "unipi,unipi-mfd", "iogroup";
				fw_variant = <0x2510>;
				fw_name = "ID-AiUC8-1";
				board_name = "IM503";
				cycle_counter = <1021>;
				master_watchdog_enable = <16>;

				ai_chip {
					compatible = "unipi,ai12";
					io-count = <8>;
					io-value-reg = <0>;
					io-mode-reg = <1010>;
					raw-value-reg = <17>;
				};
			};
		};
	};
};
