/dts-v1/;


/plugin/;

/ {
	fragment@1 {
		
		target = <&ecspi2>;
		__overlay__ {
			status = "okay";
			#address-cells = <1>;
			#size-cells = <0>;

			unipispi32: unipispi@0 {
				compatible = "unipispi";
				reg = <0>;
				status = "okay";
				spi-max-frequency = <12000000>;
				modbus-address = <32>;
				neuron-board-index = <0>;
			};
		};

	};

	fragment@2 {
		target = <&unipispi32>;
		__overlay__ {
			#address-cells = <1>;
			#size-cells = <0>;

			iogroup32 {
				reg = <32>;
				compatible = "unipi,unipi-mfd", "iogroup";
				fw_variant = <0x2520>;
				fw_name = "ID-AiUC8-2";
				cycle_counter = <1018>;
				master_watchdog_enable = <16>;

				iio_chip {
					compatible = "unipi,ai18";
					io-count = <8>;
					io-value-reg = <0>;
					io-mode-reg = <1010>;
				};
			};
		};
	};
};
