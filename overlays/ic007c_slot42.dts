/dts-v1/;


/plugin/;

/ {
	fragment@1 {
		
		target = <&ecspi3>;
		__overlay__ {
			status = "okay";
			#address-cells = <1>;
			#size-cells = <0>;

			unipispi42: unipispi@3 {
				compatible = "unipispi";
				reg = <3>;
				status = "okay";
				spi-max-frequency = <12000000>;
				modbus-address = <42>;
				neuron-board-index = <3>;
			};
		};

	};

	fragment@2 {
		target = <&unipispi42>;
		__overlay__ {
			#address-cells = <1>;
			#size-cells = <0>;

			iogroup42 {
				reg = <42>;
				compatible = "unipi,unipi-mfd", "iogroup";
				fw_variant = <0x1910>;
				fw_name = "IC-DiS4-1";
				board_name = "IC-DiS4-1";
				cycle_counter = <1014>;
				master_watchdog_enable = <1>;

				di {
					compatible = "unipi,gpio-di";
					ngpio = <4>;
					value-reg = <0>;
					debounce-reg = <1010>;
					counter-reg = <2>;
				};
			};
		};
	};
};
