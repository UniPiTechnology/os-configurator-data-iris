/dts-v1/;


/plugin/;

/ {
	fragment@1 {
		
		target = <&ecspi3>;
		__overlay__ {
			status = "okay";
			#address-cells = <1>;
			#size-cells = <0>;

			unipispi32: unipispi@2 {
				compatible = "unipispi";
				reg = <2>;
				status = "okay";
				spi-max-frequency = <12000000>;
				modbus-address = <32>;
				neuron-board-index = <2>;
			};
		};

	};

	fragment@2 {
		target = <&unipispi32>;
		__overlay__ {
			#address-cells = <1>;
			#size-cells = <0>;

			iogroup32 {
				reg = <32>;
				compatible = "unipi,unipi-mfd", "iogroup";
				fw_variant = <0x1910>;
				fw_name = "IC-DiS4-1";
				board_name = "IC-DiS4-1";
				cycle_counter = <1014>;
				master_watchdog_enable = <1>;

				di {
					compatible = "unipi,gpio-di";
					ngpio = <4>;
					value-reg = <0>;
					debounce-reg = <1010>;
					counter-reg = <2>;
				};
			};
		};
	};
};
