/dts-v1/;


/plugin/;

/ {
	fragment@1 {
		
		target = <&ecspi3>;
		__overlay__ {
			status = "okay";
			#address-cells = <1>;
			#size-cells = <0>;

			unipispi42: unipispi@1 {
				compatible = "unipispi";
				reg = <1>;
				status = "okay";
				spi-max-frequency = <6000000>;
				modbus-address = <42>;
				neuron-board-index = <1>;
			};
		};

	};

	fragment@2 {
		target = <&unipispi42>;
		__overlay__ {
			#address-cells = <1>;
			#size-cells = <0>;
			probe-always-succeeds = <1>;
			iogroup42 {
				reg = <42>;
				compatible = "unipi,unipi-mfd", "iogroup";
			};
		};
	};
};
