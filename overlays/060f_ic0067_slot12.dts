#include <dt-bindings/interrupt-controller/arm-gic.h>
#include "imx8mm-pinfunc.h"

/dts-v1/;


/plugin/;

/ {
	fragment@1 {
		
		target = <&ecspi3>;
		__overlay__ {
			status = "okay";
			#address-cells = <1>;
			#size-cells = <0>;

			unipispi12: unipispi@0 {
				compatible = "unipispi";
				reg = <0>;
				status = "okay";
				spi-max-frequency = <12000000>;
				modbus-address = <12>;
				neuron-board-index = <0>;
			};
		};

	};

	fragment@2 {
		target = <&unipispi12>;
		__overlay__ {
			#address-cells = <1>;
			#size-cells = <0>;

			iogroup12 {
				reg = <12>;
				compatible = "unipi,unipi-mfd", "iogroup";
				fw_variant = <0x1A10>, <0x1A00>;
				fw_name = "IC-Light1P-1";
				board_name = "IC-Light1P-1";
				cycle_counter = <1026>;
				master_watchdog_enable = <6>;

				dali {
					/*
				pinctrl-names = "default";
				pinctrl-0 = <&pinctrl_slotirq0>;
				interrupt-parent = <&gpio5>;
				interrupts = <20 0>;*/
					compatible = "unipi,dali";
					status-reg = <0>;
				};
			};
		};
	};

};
