/dts-v1/;


/plugin/;

/ {
	fragment@1 {
		
		target = <&ecspi3>;
		__overlay__ {
			status = "okay";
			#address-cells = <1>;
			#size-cells = <0>;

			unipispi52: unipispi@4 {
				compatible = "unipispi";
				reg = <4>;
				status = "okay";
				spi-max-frequency = <12000000>;
				modbus-address = <52>;
				neuron-board-index = <4>;
			};
		};

	};

	fragment@2 {
		target = <&unipispi52>;
		__overlay__ {
			#address-cells = <1>;
			#size-cells = <0>;

			iogroup52 {
				reg = <52>;
				compatible = "unipi,unipi-mfd", "iogroup";
				fw_variant = <0x1900>;
				fw_name = "IC-DiS4-0";
				board_name = "IC-DiS4-0";
				cycle_counter = <1014>;
				master_watchdog_enable = <1>;

				di {
					compatible = "unipi,gpio-di";
					ngpio = <4>;
					value-reg = <0>;
					debounce-reg = <1010>;
					counter-reg = <2>;
				};
			};
		};
	};
};
