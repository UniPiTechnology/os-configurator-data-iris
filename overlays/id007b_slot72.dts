/dts-v1/;


/plugin/;

/ {
	fragment@1 {
		
		target = <&ecspi2>;
		__overlay__ {
			status = "okay";
			#address-cells = <1>;
			#size-cells = <0>;

			unipispi72: unipispi@1 {
				compatible = "unipispi";
				reg = <1>;
				status = "okay";
				spi-max-frequency = <12000000>;
				modbus-address = <72>;
				neuron-board-index = <1>;
			};
		};

	};

	fragment@2 {
		target = <&unipispi72>;
		__overlay__ {
			#address-cells = <1>;
			#size-cells = <0>;

			iogroup72 {
				reg = <72>;
				compatible = "unipi,unipi-mfd", "iogroup";
				fw_variant = <0x2520>;
				fw_name = "ID-AiUC8-2";
				cycle_counter = <1018>;
				master_watchdog_enable = <16>;

				iio_chip {
					compatible = "unipi,ai18";
					io-count = <8>;
					io-value-reg = <0>;
					io-mode-reg = <1010>;
				};
			};
		};
	};
};
