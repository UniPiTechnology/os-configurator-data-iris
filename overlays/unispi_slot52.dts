/dts-v1/;


/plugin/;

/ {
	fragment@1 {
		
		target = <&ecspi3>;
		__overlay__ {
			status = "okay";
			#address-cells = <1>;
			#size-cells = <0>;

			unipispi52: unipispi@4 {
				compatible = "unipispi";
				reg = <4>;
				status = "okay";
				spi-max-frequency = <6000000>;
				modbus-address = <52>;
				neuron-board-index = <4>;
			};
		};

	};

	fragment@2 {
		target = <&unipispi52>;
		__overlay__ {
			#address-cells = <1>;
			#size-cells = <0>;
			probe-always-succeeds = <1>;
			iogroup52 {
				reg = <52>;
				compatible = "unipi,unipi-mfd", "iogroup";
			};
		};
	};
};
