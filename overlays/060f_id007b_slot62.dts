/dts-v1/;


/plugin/;

/ {
	fragment@1 {
		
		target = <&ecspi3>;
		__overlay__ {
			status = "okay";
			#address-cells = <1>;
			#size-cells = <0>;

			unipispi62: unipispi@3 {
				compatible = "unipispi";
				reg = <3>;
				status = "okay";
				spi-max-frequency = <12000000>;
				modbus-address = <62>;
				neuron-board-index = <3>;
			};
		};

	};

	fragment@2 {
		target = <&unipispi62>;
		__overlay__ {
			#address-cells = <1>;
			#size-cells = <0>;

			iogroup62 {
				reg = <62>;
				compatible = "unipi,unipi-mfd", "iogroup";
				fw_variant = <0x2520>;
				fw_name = "ID-AiUC8-2";
				cycle_counter = <1018>;
				master_watchdog_enable = <16>;

				iio_chip {
					compatible = "unipi,ai18";
					io-count = <8>;
					io-value-reg = <0>;
					io-mode-reg = <1010>;
				};
			};
		};
	};
};
