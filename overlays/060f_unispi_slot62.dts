/dts-v1/;


/plugin/;

/ {
	fragment@1 {
		
		target = <&ecspi3>;
		__overlay__ {
			status = "okay";
			#address-cells = <1>;
			#size-cells = <0>;

			unipispi62: unipispi@3 {
				compatible = "unipispi";
				reg = <3>;
				status = "okay";
				spi-max-frequency = <6000000>;
				modbus-address = <62>;
				neuron-board-index = <3>;
			};
		};

	};

	fragment@2 {
		target = <&unipispi62>;
		__overlay__ {
			#address-cells = <1>;
			#size-cells = <0>;
			probe-always-succeeds = <1>;
			iogroup62 {
				reg = <62>;
				compatible = "unipi,unipi-mfd", "iogroup";
			};
		};
	};
};
