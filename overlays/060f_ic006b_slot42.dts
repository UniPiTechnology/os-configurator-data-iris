/dts-v1/;


/plugin/;

/ {
	fragment@1 {
		
		target = <&ecspi3>;
		__overlay__ {
			status = "okay";
			#address-cells = <1>;
			#size-cells = <0>;

			unipispi42: unipispi@1 {
				compatible = "unipispi";
				reg = <1>;
				status = "okay";
				spi-max-frequency = <6000000>;
				modbus-address = <42>;
				neuron-board-index = <1>;
			};
		};

	};

	fragment@2 {
		target = <&unipispi42>;
		__overlay__ {
			#address-cells = <1>;
			#size-cells = <0>;

			iogroup42 {
				reg = <42>;
				compatible = "unipi,unipi-mfd", "iogroup";
				fw_variant = <0x2610>;
				fw_name = "IC-AoU4-1";
				board_name = "IM502";
				cycle_counter = <1010>;
				master_watchdog_enable = <4>;

				ao_chip {
                                    compatible = "unipi,ao";
                                    io-count = <4>;
                                    io-value-reg = <0>;
                                };
			};
		};
	};
};
