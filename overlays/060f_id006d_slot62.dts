/dts-v1/;


/plugin/;

/ {
	fragment@1 {
		
		target = <&ecspi3>;
		__overlay__ {
			status = "okay";
			#address-cells = <1>;
			#size-cells = <0>;

			unipispi62: unipispi@3 {
				compatible = "unipispi";
				reg = <3>;
				status = "okay";
				spi-max-frequency = <6000000>;
				modbus-address = <62>;
				neuron-board-index = <3>;
			};
		};

	};

	fragment@2 {
		target = <&unipispi62>;
		__overlay__ {
			#address-cells = <1>;
			#size-cells = <0>;

			iogroup62 {
				reg = <62>;
				compatible = "unipi,unipi-mfd", "iogroup";
				fw_variant = <0x2710>;
				fw_name = "ID-AiRTD8-1";
				board_name = "IM504";
				cycle_counter = <1020>;
				master_watchdog_enable = <25>;
				ai_chip {
					compatible = "unipi,airtd";
					io-count = <8>;
					io-value-reg = <0>;
					io-mode-reg = <1010>;
					raw-value-reg = <16>;
				};
			};
		};
	};
};
