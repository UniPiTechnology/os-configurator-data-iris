/dts-v1/;


/plugin/;

/ {
	fragment@1 {
		
		target = <&ecspi2>;
		__overlay__ {
			status = "okay";
			#address-cells = <1>;
			#size-cells = <0>;

			unipispi11: unipispi@0 {
				compatible = "unipispi";
				reg = <0>;
				status = "okay";
				spi-max-frequency = <6000000>;
				modbus-address = <11>;
				neuron-board-index = <0>;
			};
		};

	};

	fragment@2 {
		target = <&unipispi11>;
		__overlay__ {
			#address-cells = <1>;
			#size-cells = <0>;
			probe-always-succeeds = <1>;
			iogroup11 {
				reg = <11>;
				compatible = "unipi,unipi-mfd", "iogroup";
			};
		};
	};
};
