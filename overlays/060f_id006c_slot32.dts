/dts-v1/;


/plugin/;

/ {
	fragment@1 {
		
		target = <&ecspi2>;
		__overlay__ {
			status = "okay";
			#address-cells = <1>;
			#size-cells = <0>;

			unipispi32: unipispi@0 {
				compatible = "unipispi";
				reg = <0>;
				status = "okay";
				spi-max-frequency = <12000000>;
				modbus-address = <32>;
				neuron-board-index = <0>;
			};
		};

	};

	fragment@2 {
		target = <&unipispi32>;
		__overlay__ {
			#address-cells = <1>;
			#size-cells = <0>;

			iogroup32 {
				reg = <32>;
				compatible = "unipi,unipi-mfd", "iogroup";
				fw_variant = <0x2510>;
				fw_name = "ID-AiUC8-1";
				board_name = "IM503";
				cycle_counter = <1021>;
				master_watchdog_enable = <16>;

				ai_chip {
					compatible = "unipi,ai12";
					io-count = <8>;
					io-value-reg = <0>;
					io-mode-reg = <1010>;
					raw-value-reg = <17>;
				};
			};
		};
	};
};
