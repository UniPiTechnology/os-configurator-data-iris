/dts-v1/;


/plugin/;

/ {
	fragment@1 {
		
		target = <&ecspi3>;
		__overlay__ {
			status = "okay";
			#address-cells = <1>;
			#size-cells = <0>;

			unipispi62: unipispi@3 {
				compatible = "unipispi";
				reg = <3>;
				status = "okay";
				spi-max-frequency = <12000000>;
				modbus-address = <62>;
				neuron-board-index = <3>;
			};
		};

	};

	fragment@2 {
		target = <&unipispi62>;
		__overlay__ {
			#address-cells = <1>;
			#size-cells = <0>;

			iogroup62 {
				reg = <62>;
				compatible = "unipi,unipi-mfd", "iogroup";
				fw_variant = <0x1900>;
				fw_name = "IC-DiS4-0";
				board_name = "IC-DiS4-0";
				cycle_counter = <1014>;
				master_watchdog_enable = <1>;

				di {
					compatible = "unipi,gpio-di";
					ngpio = <4>;
					value-reg = <0>;
					debounce-reg = <1010>;
					counter-reg = <2>;
				};
			};
		};
	};
};
